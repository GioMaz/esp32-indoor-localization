## components/gpio/Kconfig.projbuild
```kconfig
menu "GPIO Config"
    config RIGHT_BTN
        int "Right Button Pin"
        default 21

    config TOP_BTN
        int "Top Button Pin"
        default 3

    config DOWN_BTN
        int "Down Button Pin"
        default 22

    config LEFT_BTN
        int "Left Button Pin"
        default 23

    config SCAN_BTN
        int "Scan Button Pin"
        default 19

    config MODE_BTN
        int "Mode Switch Button Pin"
        default 18
endmenu
```

## components/wifi/Kconfig.projbuild
```kconfig
menu "AP Config"
    config ESP_AP_SSID
        string "Access Point SSID"
        default "esp32-indoor-localization"

    config ESP_AP_PASSWORD
        string "Access Point Password"
        default "123456789"

    config ESP_AP_SCAN_SSID
        string "Access Point SSID Filter"
        default "unitn-x"

    config ESP_MAX_STA_CONN
        int "Maximal STA connections"
        default 4

endmenu
```
